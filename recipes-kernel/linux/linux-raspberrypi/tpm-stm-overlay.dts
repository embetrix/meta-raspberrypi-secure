/dts-v1/;

/ {
	compatible = "brcm,bcm2835", "brcm,bcm2708", "brcm,bcm2709";

	fragment@0 {
		target = <0xffffffff>;

		__overlay__ {
			status = "disabled";
		};
	};

	fragment@1 {
		target-path = "/";

		__overlay__ {

			i2c-gpio@1 {
				#address-cells = <0x01>;
				#size-cells = <0x00>;
				compatible = "i2c-gpio";
				gpios = <0xffffffff 0x02 0x06 0xffffffff 0x03 0x06>;
				clock-frequency = <0x30d40>;
				status = "okay";
				phandle = <0x01>;
			};
		};
	};

	fragment@2 {
		target = <0x01>;

		__overlay__ {
			#address-cells = <0x01>;
			#size-cells = <0x00>;

			tpmSTM@2e {
				compatible = "infineon,slb9673\0tcg,tpm-tis-i2c";
				reg = <0x2e>;
				status = "okay";
				phandle = <0x02>;
			};
		};
	};

	fragment@3 {
		target = <0xffffffff>;

		__overlay__ {
			status = "okay";
		};
	};

	fragment@4 {
		target = <0xffffffff>;

		__overlay__ {
			status = "disabled";
		};
	};

	fragment@5 {
		target = <0xffffffff>;

		__overlay__ {
			#address-cells = <0x01>;
			#size-cells = <0x00>;

			tpmSTMspi@1 {
				compatible = "st,st33htpm-spi";
				reg = <0x00>;
				#address-cells = <0x01>;
				#size-cells = <0x00>;
				spi-max-frequency = <0x1036640>;
				status = "okay";
				phandle = <0x03>;
			};
		};
	};

	__symbols__ {
		i2c1 = "/fragment@1/__overlay__/i2c-gpio@1";
		tpmSTM = "/fragment@2/__overlay__/tpmSTM@2e";
		tpmSTMspi = "/fragment@5/__overlay__/tpmSTMspi@1";
	};

	__fixups__ {
		i2c_arm = "/fragment@0:target:0";
		gpio = "/fragment@1/__overlay__/i2c-gpio@1:gpios:0\0/fragment@1/__overlay__/i2c-gpio@1:gpios:12";
		spi0 = "/fragment@3:target:0\0/fragment@5:target:0";
		spidev1 = "/fragment@4:target:0";
	};

	__local_fixups__ {

		fragment@2 {
			target = <0x00>;
		};
	};
};
